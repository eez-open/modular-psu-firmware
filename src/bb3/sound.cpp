/*
 * EEZ Modular Firmware
 * Copyright (C) 2015-present, Envox d.o.o.
 *
 * This program is free software: you can redistribute it and/or modify
 * it under the terms of the GNU General Public License as published by
 * the Free Software Foundation, either version 3 of the License, or
 * (at your option) any later version.

 * This program is distributed in the hope that it will be useful,
 * but WITHOUT ANY WARRANTY; without even the implied warranty of
 * MERCHANTABILITY or FITNESS FOR A PARTICULAR PURPOSE.  See the
 * GNU General Public License for more details.

 * You should have received a copy of the GNU General Public License
 * along with this program.  If not, see <http://www.gnu.org/licenses/>.
 */

#include <math.h>
#include <memory.h>
#include <assert.h>

#if defined(EEZ_PLATFORM_SIMULATOR) && !defined(__EMSCRIPTEN__)

#include <cmath>
#include <queue>
#include <stdio.h>
#include <SDL.h>
#include <SDL_audio.h>

#elif defined(EEZ_PLATFORM_STM32)

#include <math.h>
#include <dac.h>
#include <tim.h>
#endif

#include <eez/core/sound.h>
#include <eez/core/os.h>
#include <eez/core/memory.h>
#include <bb3/psu/psu.h>
#include <bb3/psu/persist_conf.h>

#define NOTE_B0 31.0f
#define NOTE_C1 33.0f
#define NOTE_CS1 35.0f
#define NOTE_D1 37.0f
#define NOTE_DS1 39.0f
#define NOTE_E1 41.0f
#define NOTE_F1 44.0f
#define NOTE_FS1 46.0f
#define NOTE_G1 49.0f
#define NOTE_GS1 52.0f
#define NOTE_A1 55.0f
#define NOTE_AS1 58.0f
#define NOTE_B1 62.0f
#define NOTE_C2 65.0f
#define NOTE_CS2 69.0f
#define NOTE_D2 73.0f
#define NOTE_DS2 78.0f
#define NOTE_E2 82.0f
#define NOTE_F2 87.0f
#define NOTE_FS2 93.0f
#define NOTE_G2 98.0f
#define NOTE_GS2 104.0f
#define NOTE_A2 110.0f
#define NOTE_AS2 117.0f
#define NOTE_B2 123.0f
#define NOTE_C3 131.0f
#define NOTE_CS3 139.0f
#define NOTE_D3 147.0f
#define NOTE_DS3 156.0f
#define NOTE_E3 165.0f
#define NOTE_F3 175.0f
#define NOTE_FS3 185.0f
#define NOTE_G3 196.0f
#define NOTE_GS3 208.0f
#define NOTE_A3 220.0f
#define NOTE_AS3 233.0f
#define NOTE_B3 247.0f
#define NOTE_C4 262.0f
#define NOTE_CS4 277.0f
#define NOTE_D4 294.0f
#define NOTE_DS4 311.0f
#define NOTE_E4 330.0f
#define NOTE_F4 349.0f
#define NOTE_FS4 370.0f
#define NOTE_G4 392.0f
#define NOTE_GS4 415.0f
#define NOTE_A4 440.0f
#define NOTE_AS4 466.0f
#define NOTE_B4 494.0f
#define NOTE_C5 523.0f
#define NOTE_CS5 554.0f
#define NOTE_D5 587.0f
#define NOTE_DS5 622.0f
#define NOTE_E5 659.0f
#define NOTE_F5 698.0f
#define NOTE_FS5 740.0f
#define NOTE_G5 784.0f
#define NOTE_GS5 831.0f
#define NOTE_A5 880.0f
#define NOTE_AS5 932.0f
#define NOTE_B5 988.0f
#define NOTE_C6 1047.0f
#define NOTE_CS6 1109.0f
#define NOTE_D6 1175.0f
#define NOTE_DS6 1245.0f
#define NOTE_E6 1319.0f
#define NOTE_F6 1397.0f
#define NOTE_FS6 1480.0f
#define NOTE_G6 1568.0f
#define NOTE_GS6 1661.0f
#define NOTE_A6 1760.0f
#define NOTE_AS6 1865.0f
#define NOTE_B6 1976.0f
#define NOTE_C7 2093.0f
#define NOTE_CS7 2217.0f
#define NOTE_D7 2349.0f
#define NOTE_DS7 2489.0f
#define NOTE_E7 2637.0f
#define NOTE_F7 2794.0f
#define NOTE_FS7 2960.0f
#define NOTE_G7 3136.0f
#define NOTE_GS7 3322.0f
#define NOTE_A7 3520.0f
#define NOTE_AS7 3729.0f
#define NOTE_B7 3951.0f
#define NOTE_C8 4186.0f
#define NOTE_CS8 4435.0f
#define NOTE_D8 4699.0f
#define NOTE_DS8 4978.0f

namespace eez {
namespace sound {

////////////////////////////////////////////////////////////////////////////////

enum {
	CLICK_TUNE,
	SHUTTER_TUNE,
	BEEP_TUNE,
	POWER_UP_TUNE,
	POWER_DOWN_TUNE
};

#if !defined(__EMSCRIPTEN__)

static const float g_clickTune[] = {
#if defined(EEZ_PLATFORM_SIMULATOR)
    440.0f, 1.0f / 32.0f,
#else
    860.0f, 0.01f,
#endif
	NAN // end!
};

static const float g_beepTune[] = {
	NOTE_C6, 1/4.0f,
    NAN // end!
};

static const float g_powerUpTune[] = {
    NOTE_C6, 1/8.0f,
    NOTE_C6, 1/2.0f,
    NAN // end!
};

static const float g_powerDownTune[] = {
    NOTE_C6, 1/10.0f,
    NOTE_A5, 1/10.0f,
    NOTE_G5, 1/5.0f,
    NAN // end!
};

#endif

#if defined(EEZ_PLATFORM_SIMULATOR) && !defined(__EMSCRIPTEN__)
static const int16_t g_shutterSamples[] = {
0, -1, 1, 0, 0, 0, 0, -1, 2, -2, 4, -5, 6, -7, 8, -5, 3, 0, -2, 4,
-3, 4, -3, 4, -4, 4, 0, -2, 7, -7, 7, -3, 2, 2, -2, 5, -4, 6, -3, 4,
1, 0, 2, 1, 2, 2, 1, 1, 4, -1, 4, 1, 2, 4, 1, 2, 3, 0, 6, -1,
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-167, -152, -146, -144, -135, -107, -83, -82, -88, -107, -131, -143, -137, -131, -134, 0	
};
static const size_t g_shutterSamplesSize = sizeof(g_shutterSamples) / sizeof(int16_t);
#endif

#if defined(EEZ_PLATFORM_STM32)
static const uint8_t g_shutterSamples[16377] = {
255, 0, 0, 255, 0, 255, 0, 255, 0, 255, 0, 255, 0, 255, 0, 255, 0, 255, 0, 255, 0, 255, 0, 255, 
0, 255, 0, 255, 0, 255, 0, 255, 0, 255, 0, 255, 0, 255, 0, 255, 0, 255, 0, 255, 0, 255, 0, 255, 
0, 255, 0, 255, 0, 255, 0, 255, 0, 255, 0, 255, 0, 255, 0, 255, 0, 255, 0, 255, 0, 255, 0, 255, 
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0, 255, 0, 255, 0, 255, 0, 255, 0
};
static const size_t g_shutterSamplesSize = sizeof(g_shutterSamples) / sizeof(uint8_t);
#endif

struct Tune {
	const float *tune;
	uint32_t sampleRate;
	float durationBetweenNotesFactor;
#if defined(EEZ_PLATFORM_SIMULATOR)
	int16_t *pSamples;
#elif defined(EEZ_PLATFORM_STM32)
	uint8_t *pSamples;
#endif
	unsigned int numSamples;
};

#if !defined(__EMSCRIPTEN__)

#if defined(EEZ_PLATFORM_SIMULATOR)
#define SAMPLE_RATE 48000
#elif defined(EEZ_PLATFORM_STM32)
#define SAMPLE_RATE 12000
#endif

static Tune g_tunes[] = {
	{ g_clickTune, SAMPLE_RATE, 1.3f },
#if defined(EEZ_PLATFORM_SIMULATOR)
	{ nullptr, 48000, 0, (int16_t *)g_shutterSamples, g_shutterSamplesSize },
#elif defined(EEZ_PLATFORM_STM32)
	{ nullptr, 48000, 0, (uint8_t *)g_shutterSamples, g_shutterSamplesSize },
#endif
	{ g_beepTune, SAMPLE_RATE, 1.3f },
	{ g_powerUpTune, SAMPLE_RATE, 1.3f },
	{ g_powerDownTune, SAMPLE_RATE, 0.75f }
};

#endif

static int g_playNextTuneIndex = -1;
static int g_currentTuneIndex = -1;
static uint32_t g_currentTuneStartPlayTime;

////////////////////////////////////////////////////////////////////////////////

#define PI 3.14159265f

#if defined(EEZ_PLATFORM_SIMULATOR) && !defined(__EMSCRIPTEN__)
static const uint32_t g_memoryForTuneSamplesSize = 256000;
int16_t g_memoryForTuneSamples[g_memoryForTuneSamplesSize];
SDL_AudioDeviceID g_audioDevice;
#elif defined(EEZ_PLATFORM_STM32)
static const uint32_t g_memoryForTuneSamplesSize = SOUND_TUNES_MEMORY_SIZE;
uint8_t *g_memoryForTuneSamples = SOUND_TUNES_MEMORY;
#endif

#if !defined(__EMSCRIPTEN__)

uint32_t g_memoryForTuneSamplesOffset;

#if defined(EEZ_PLATFORM_SIMULATOR)
unsigned int generateTuneSamples(const float *tune, int sampleRate, int16_t *pMemBuffer, float durationBetweenNotesFactor) {
#elif defined(EEZ_PLATFORM_STM32)
unsigned int generateTuneSamples(const float *tune, int sampleRate, uint8_t *pMemBuffer, float durationBetweenNotesFactor) {
#endif

    unsigned int size = 0;
	for (int i = 0; !isNaN(tune[i]); i += 2) {
        if (i > 0) {
            // add silence between notes
			unsigned int silence = (unsigned int)roundf(durationBetweenNotesFactor * sampleRate * tune[i - 1]);
            memset(pMemBuffer, 0, silence * sizeof(uint16_t));
			size += silence;
            pMemBuffer += silence;
		}

		unsigned int duration = (unsigned int)roundf(sampleRate * tune[i + 1]);
		size += duration;
		
        float f = 2 * PI * tune[i] / sampleRate;

		for (unsigned int k = 0; k < duration; k++) {
#if defined(EEZ_PLATFORM_SIMULATOR)
			*pMemBuffer++ = (int16_t)clamp(32767.5f * sinf(k * f), -32768.0f, 32767.0f);
#elif defined(EEZ_PLATFORM_STM32)
			*pMemBuffer++ = (uint8_t)clamp(127.5f + 127.5f * sinf(k * f), 0.0f, 255.0f);
#endif
		}

	}

	// add zero to the end
	*pMemBuffer = 0;
	size++;

	return size;
}

#endif

////////////////////////////////////////////////////////////////////////////////

#if !defined(__EMSCRIPTEN__)
void initTune(Tune &tuneDef) {
    if (!tuneDef.pSamples) {
		tuneDef.pSamples = g_memoryForTuneSamples + g_memoryForTuneSamplesOffset;
		tuneDef.numSamples = generateTuneSamples(tuneDef.tune, tuneDef.sampleRate, tuneDef.pSamples, tuneDef.durationBetweenNotesFactor);
        g_memoryForTuneSamplesOffset += tuneDef.numSamples;
        assert(g_memoryForTuneSamplesOffset * sizeof(uint8_t) <= g_memoryForTuneSamplesSize);
	}
}
#endif

void init() {
#if !defined(__EMSCRIPTEN__)
	initTune(g_tunes[POWER_UP_TUNE]);
#endif

#if defined(EEZ_PLATFORM_SIMULATOR) && !defined(__EMSCRIPTEN__)
	SDL_InitSubSystem(SDL_INIT_AUDIO);

	SDL_AudioSpec desiredSpec;

	SDL_memset(&desiredSpec, 0, sizeof(desiredSpec));

	desiredSpec.freq = SAMPLE_RATE;
	desiredSpec.format = AUDIO_S16SYS;
	desiredSpec.channels = 1;
	desiredSpec.samples = 2048;

	SDL_AudioSpec obtainedSpec;

	g_audioDevice = SDL_OpenAudioDevice(NULL, 0, &desiredSpec, &obtainedSpec, 0);
	if (g_audioDevice == 0) {
		printf("Failed to open audio: %s\n", SDL_GetError());
	}
#endif
}

void startPlay(int iTune) {
#if !defined(__EMSCRIPTEN__)
    Tune &tuneDef = g_tunes[iTune];
	initTune(tuneDef);
#if defined(EEZ_PLATFORM_SIMULATOR)
    SDL_QueueAudio(g_audioDevice, tuneDef.pSamples, tuneDef.numSamples * 2);
    SDL_PauseAudioDevice(g_audioDevice, 0);
#elif defined(EEZ_PLATFORM_STM32)
	HAL_DAC_Stop_DMA(&hdac, DAC_CHANNEL_1);
	HAL_TIM_Base_Stop(&htim6);
	HAL_TIM_Base_DeInit(&htim6);
	htim6.Init.Period = 108000000 / tuneDef.sampleRate - 1;
	HAL_TIM_Base_Init(&htim6);
	HAL_TIM_Base_Start(&htim6);
	HAL_DAC_Start_DMA(&hdac, DAC_CHANNEL_1, (uint32_t *)tuneDef.pSamples, tuneDef.numSamples, DAC_ALIGN_8B_R);
#endif
#endif
}

void tick() {
#if !defined(__EMSCRIPTEN__)
#if defined(EEZ_PLATFORM_SIMULATOR)
	if (!g_audioDevice) {
		return;
	}
#endif

	if (g_currentTuneIndex != -1) {
		Tune &tuneDef = g_tunes[g_currentTuneIndex];
		uint32_t duration = tuneDef.numSamples * 1000 / tuneDef.sampleRate;
		if (millis() - g_currentTuneStartPlayTime > duration) {
			g_currentTuneIndex = -1;
		}
	}

	int iTune = g_playNextTuneIndex;
	if (iTune != -1) {
		g_currentTuneIndex = g_playNextTuneIndex;
		g_playNextTuneIndex = -1;

    	startPlay(g_currentTuneIndex);

        g_currentTuneStartPlayTime = millis();
	}
#endif
}

static void playTune(int iTune) {
	if (iTune > g_playNextTuneIndex && iTune > g_currentTuneIndex) {
		g_playNextTuneIndex = iTune;
    	if (
			isLowPriorityThread() ||
			isPsuThread() ||
			g_playNextTuneIndex == POWER_UP_TUNE ||
			(g_playNextTuneIndex == BEEP_TUNE && !g_isBooted)
		) {
			tick();
		} else {
			sendMessageToLowPriorityThread(THREAD_MESSAGE_SOUND_TICK);
		}
	}
}

void playPowerUp(PlayPowerUpCondition condition) {
#if OPTION_DISPLAY
	static PlayPowerUpCondition g_playPowerUpCondition;
	if (
		(condition == PLAY_POWER_UP_CONDITION_WELCOME_PAGE_IS_ACTIVE && g_playPowerUpCondition == PLAY_POWER_UP_CONDITION_TEST_SUCCESSFUL) ||
		(condition == PLAY_POWER_UP_CONDITION_TEST_SUCCESSFUL && g_playPowerUpCondition == PLAY_POWER_UP_CONDITION_WELCOME_PAGE_IS_ACTIVE)
	) {
		g_playPowerUpCondition = PLAY_POWER_UP_CONDITION_NONE;
    	if (psu::persist_conf::isSoundEnabled()) {
			playTune(POWER_UP_TUNE);
    	}
	} else {
		g_playPowerUpCondition = condition;
	}
#else
	if (condition == PLAY_POWER_UP_CONDITION_TEST_SUCCESSFUL) {
    	if (psu::persist_conf::isSoundEnabled()) {
			playTune(POWER_UP_TUNE);
    	}
	}
#endif
}

void playPowerDown() {
    if (psu::persist_conf::isSoundEnabled()) {
		playTune(POWER_DOWN_TUNE);
    }
}

void playBeep(bool force) {
    if (force || psu::persist_conf::isSoundEnabled()) {
		playTune(BEEP_TUNE);
    }
}

void playClick() {
    if (psu::persist_conf::isClickSoundEnabled()) {
		playTune(CLICK_TUNE);
    }
}

void playShutter() {
    if (psu::persist_conf::isSoundEnabled()) {
		playTune(SHUTTER_TUNE);
    }
}

} // namespace sound
} // namespace eez
